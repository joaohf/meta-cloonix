## conf/layer.conf
```bitbake
# We have a conf and classes directory, add to BBPATH
BBPATH .= ":${LAYERDIR}"

# We have recipes-* directories, add to BBFILES
BBFILES += "${LAYERDIR}/recipes-*/*/*.bb \
            ${LAYERDIR}/recipes-*/*/*.bbappend"

BBFILE_COLLECTIONS += "meta-cloonix"
BBFILE_PATTERN_meta-cloonix = "^${LAYERDIR}/"
BBFILE_PRIORITY_meta-cloonix = "6"

LAYERDEPENDS_meta-cloonix = "core"
LAYERSERIES_COMPAT_meta-cloonix = "hardknott gatesgarth dunfell zeus warrior"
```

## wic/cloonix-qemux86-directdisk.wks
```
# short-description: Create a qemu machine 'pcbios' direct disk image using Cloonix boot arguments
# long-description: Creates a partitioned legacy BIOS disk image that the user
# can directly use to boot a qemu machine.

include common.wks.inc

bootloader  --timeout=0  --append="vga=0 rw oprofile.timer=1 rootfstype=ext4 console=ttyS0 console=tty0 earlyprintk=serial net.ifnames=0 "
```
